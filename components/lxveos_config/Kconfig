## components/lxveos_config/Kconfig
```kconfig
menu "LxveOS"

    comment "Feature modules — set per board by boards/<board>/sdkconfig.defaults (generated from cyd_boards.json)."

    config LXVEOS_HAS_WIFI
        bool "Wi-Fi recon (scan/monitor/pcap; deauth = DETECTION only)"
        default y

    config LXVEOS_HAS_BLE
        bool "BLE recon (NimBLE scan/analyze)"
        default n

    config LXVEOS_HAS_BT_CLASSIC
        bool "Bluetooth Classic (classic ESP32 only)"
        default n

    config LXVEOS_HAS_DISPLAY
        bool "On-device display + LVGL UI (esp_lcd / esp_lvgl_port)"
        default n

    config LXVEOS_HAS_STORAGE
        bool "SD / FAT / LittleFS storage (pcap, WiGLE CSV, configs)"
        default n

    config LXVEOS_HAS_GPS
        bool "GPS (wardrive coords + time)"
        default n

    config LXVEOS_HAS_IR
        bool "IR capture/replay (on gear you own)"
        default n

    config LXVEOS_HAS_SUBGHZ
        bool "Sub-GHz via CC1101 add-on (RX/analyze + arm-gated OOK replay TX; no jammer)"
        default n

    config LXVEOS_HAS_NRF24
        bool "2.4GHz proprietary via nRF24 add-on (RX/sniff + arm-gated MouseJack inject TX; no jammer)"
        default n

    config LXVEOS_HAS_NFC
        bool "NFC/RFID via PN532 add-on (where lawful)"
        default n

    comment "Attachable add-ons — capability present as an external module on operator pins (marked \"addon\" in cyd_boards.json). Not compiled in; ops report 'attachable' until the module is wired + detected."

    config LXVEOS_ADDON_STORAGE
        bool "SD / storage is an attachable add-on on this board"
        default n

    config LXVEOS_ADDON_GPS
        bool "GPS is an attachable add-on on this board"
        default n

    config LXVEOS_ADDON_IR
        bool "IR is an attachable add-on on this board"
        default n

    config LXVEOS_ADDON_SUBGHZ
        bool "Sub-GHz (CC1101) is an attachable add-on on this board"
        default n

    config LXVEOS_ADDON_NRF24
        bool "nRF24 is an attachable add-on on this board"
        default n

    config LXVEOS_ADDON_NFC
        bool "NFC (PN532) is an attachable add-on on this board"
        default n

    comment "No jammer feature exists in any configuration. Deauth ships as detection. See RESPONSIBLE-USE.md."

endmenu
```

## sdkconfig.defaults
```kconfig
# LxveOS common defaults (all boards). Chip-family + per-board files layer on top (see CMakePresets).
CONFIG_ESP_DEFAULT_CPU_FREQ_MHZ_240=y
CONFIG_ESPTOOLPY_FLASHFREQ_80M=y
CONFIG_FREERTOS_HZ=1000

# Size-first by default; feature/PSRAM boards can override to -O2 in their per-board file.
CONFIG_COMPILER_OPTIMIZATION_SIZE=y

# Field devices: let a bad OTA self-recover.
CONFIG_BOOTLOADER_APP_ROLLBACK_ENABLE=y

# WiFi RX hot-path in IRAM (capture path). Safe default; boards tight on IRAM can disable.
CONFIG_ESP_WIFI_IRAM_OPT=y
CONFIG_ESP_WIFI_RX_IRAM_OPT=y

# Keep logs at INFO in dev; release builds override to ERROR/NONE.
CONFIG_LOG_DEFAULT_LEVEL_INFO=y

# Bluetooth LE via NimBLE (all boards declare a BLE capability). NimBLE, not Bluedroid — far smaller for a
# BLE-only use case. Recon (scan/observe) is passive. The connectable PERIPHERAL role is compiled IN for the
# one BLE transmit op — arm-gated HID keystroke injection (the `ble_hid_inject` / "BadBLE" op) — which
# advertises as a keyboard and talks to the single host that connects. The non-connectable BROADCASTER role
# stays compiled OUT: that is the role BLE advert-spam / popup-flood attacks use, and LxveOS does not build
# a spam emitter. So the image can advertise as a HID keyboard (targeted, arm-gated) but is Kconfig-incapable
# of a broadcast advert flood. The per-chip controller mode lives in sdkconfig.defaults.<target>.
CONFIG_BT_ENABLED=y
CONFIG_BT_NIMBLE_ENABLED=y
CONFIG_BT_NIMBLE_ROLE_BROADCASTER=n
CONFIG_BT_NIMBLE_ROLE_PERIPHERAL=y

# IRAM relief. The sub-GHz CC1101 driver links the SPI master, and spi_bus_add_device registers the SPI
# master ISR (IRAM-resident) — previously garbage-collected because nothing referenced it. On the tightest
# esp32 boards (m5stickc_plus2) that tips iram0_0_seg over by a few KB. LxveOS uses polling SPI transfers
# (spi_device_polling_transmit), not the SPI ISR, so move that ISR out of IRAM. Also relax the WiFi RX IRAM
# optimization for extra headroom on the small boards (a minor RX-throughput trade, fine for this tool).
CONFIG_SPI_MASTER_ISR_IN_IRAM=n
CONFIG_ESP_WIFI_RX_IRAM_OPT=n
```

## sdkconfig.defaults.esp32
```kconfig
# Chip-family defaults: classic ESP32 (WROOM/WROVER/PICO). PSRAM is NOT assumed here — most classic
# boards (CYDs, StickC) are WROOM with no PSRAM; boards that DO have it (StickC Plus2, Fire) enable it
# in their own boards/<board>/sdkconfig.defaults.
CONFIG_IDF_TARGET="esp32"
CONFIG_ESPTOOLPY_FLASHMODE_DIO=y

# Classic ESP32 has a dual-mode (BR/EDR + BLE) controller; NimBLE is BLE-only, so run the controller in
# BLE-only mode to free the BR/EDR memory. (The S3's controller is BLE-only silicon — no mode knob there.)
CONFIG_BTDM_CTRL_MODE_BLE_ONLY=y
```

## sdkconfig.defaults.esp32s3
```kconfig
# Chip-family defaults: ESP32-S3. PSRAM is NOT assumed here — the Cardputer (S3 FN8) has NO PSRAM,
# while the JC3248W535 / M5StickS3 do. Boards with PSRAM enable SPIRAM + XIP-from-PSRAM in their own
# boards/<board>/sdkconfig.defaults so each variant is tuned to its silicon.
CONFIG_IDF_TARGET="esp32s3"
CONFIG_ESPTOOLPY_FLASHMODE_DIO=y
```
